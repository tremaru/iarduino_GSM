//  Данный пример демонстрирует совершение исходящего голосового вызова с выводом состояния вызова:
//  ==========================================================================================
    #include <iarduino_GSM.h>                                                                 // Подключаем библиотеку iarduino_GSM для работы с GSM/GPRS Shield.
    iarduino_GSM gsm;                                                                         // Создаём объект gsm для работы с функциями и методами библиотеки iarduino_GSM.
                                                                                              //
//  Следующие 2 строки нужны для работы по программной шине UATR (выводы 7 и 8):              //
    #include <SoftwareSerial.h>                                                               // Подключаем библиотеку SoftwareSerial для программной реализации шины UART.
    SoftwareSerial softSerial(7,8);                                                           // Создаём объект softSerial указывая выводы RX и TX платы Arduino.
//  Если Вы работаете c GSM/GPRS Shield по аппаратной шине UATR, удалите 2 предыдущие строки, //
//  а в функции gsm.begin(), вместо softSerial укажите Serial или Serial1, Serial2 ...        // Зависит от номера аппаратной шины UART использующей выводы 0 и 1 Вашей платы Arduino.
                                                                                              //
void setup(){                                                                                 //
//  Выводим текст в монитор последовательного порта:                                          //
    Serial.begin(9600);                                                                       // Инициируем передачу данных по аппаратной шине UART для вывода результата в монитор последовательного порта.
    Serial.print( F("Initialization, please wait ... ") );                                    // Выводим текст.
                                                                                              //
//  Инициируем GSM/GPRS Shield и проверяем его готовность к работе:                           //
    gsm.begin(softSerial);                                                                    // Инициируем работу GSM/GPRS Shield, указывая объект шины UART.
    while(gsm.status()!=GSM_OK){Serial.print("."); delay(1000);} Serial.println(" OK!");      // Ждём завершения регистрации модема в сети оператора связи.
    Serial.println( F("--------------------") );                                              //
                                                                                              //
//  Инициируем исходящий вызов на указанный ниже номер:                                       // Номер можно указывать со знаком плюс ("+70123456789") или указывать короткие номера (например, "0525" - голосовая почта beeline).
    if(gsm.CALLdial( "70123456789" )){                                                        // Если исходящий вызов на номер +7(012)345-67-89 инициирован, то...
        Serial.print( "Dialing ..." );                                                        // Выводим сообщение: "Набираю ..."
//      Ждём завершения набора номера:                                                        //
        while(gsm.CALLstatus()==GSM_CALL_OUT_DIAL){                                           // Цикл выполняется пока набирается номер ...
//          Можно добавить код который будет выполняться в процессе набора номера             //
        }                                                                                     //
        delay(500);                                                                           // Даём немного времени для установки состояния - "дозвон" или "соединён".
        if(gsm.CALLstatus()==GSM_CALL_OUT_BEEP){                                              // Если начались гудки дозвона, то ...
            Serial.println( "Ok!" );                                                          // Выводим сообщение: "Ок!", оно появится после предыдущей надписи "Набираю ...".
            Serial.print  ( "Waiting for an answer ... " );                                   // Выводим сообщение: "Ждём ответа ...".
//          Ждём поднятия трубки на вызываемой стороне:                                       //
            while(gsm.CALLstatus()==GSM_CALL_OUT_BEEP){                                       // Цикл выполняется пока идут гудки дозвона ...
//              Можно добавить код который будет выполняться в процессе ожидания ответа       //
            }                                                                                 //
            delay(500);                                                                       // Даём немного времени для установки состояния - "соединён".
        }                                                                                     //
        if(gsm.CALLstatus()==GSM_CALL_ACTIVE){                                                // Если соединение установлено (абонент ответил), то ...
            Serial.println( "Ok!" );                                                          // Выводим сообщение: "Ок!", оно появится после предыдущей надписи "Ждём ответа ..." или после надписи "Набираю ..." (если абонент ответил сразу).
            Serial.println( "Voice connection established!" );                                // Выводим сообщение: "Установлено голосовое соединение!"
//          Ждём завершения активного голосового соединения:                                  //
            while(gsm.CALLstatus()==GSM_CALL_ACTIVE){                                         // Цикл выполняется пока установлено активное голосовое соединение ...
//              Можно добавить код который будет выполняться в процессе разговора             //
            }                                                                                 //
//          Разговор завершён:                                                                // Попасть сюда можно только после выхода из цикла while(), значит соединение было завершено.
            Serial.println( "Call ended" );                                                   // Выводим сообщение: "Вызов завершён".
        }else{                                                                                // Иначе, если активное голосовое соединение не было установлено, то ...
//          Если абонент не ответил, сбросил вызов или не удалось набрать номер:              //
            Serial.println( "No answer!" );                                                   // Абонент не отвечает.
        }                                                                                     //
    }else{                                                                                    // Иначе, если функция CALLdial() вернула false (исходящий вызов невозможен), то ...
//      Если не удалось инициировать исходящий вызов:                                         //
        Serial.println( "Error!" );                                                           // Выводим сообщение: "Ошибка!".
    }                                                                                         //
}                                                                                             //
                                                                                              //
void loop (){                                                                                 // В данном скетче вызов не осуществляется в цикле loop, для экономии Ваших средств на счёте.
}                                                                                             //
                                                                                              //
/*  Примечание:
 *  ==========================================================================================
 *  Перед загрузкой данного скетча измените номер телефона вызываемого абонента !!!
 *  ==========================================================================================
 *  Номер телефона можно указывать как с символом +, так и без него, а так же можно указывать короткие номера.
 *  Вызов осуществляется функцией CALLdial(), остальная часть кода необязательна (см. пример call_outgoing_mini), она лишь отслеживает и выводит состояние вызова: набор, дозвон, соединение, разрыв.
 *  Состояние GSM_CALL_OUT_BEEP (дозвон) может отсутствовать, тогда за состоянием GSM_CALL_OUT_DIAL (набор) сразу следует состояние GSM_CALL_ACTIVE (соединение).
 *  При разрыве соединения формируется состояние GSM_CALL_END (разъединение), за которым следует состояние GSM_OK (линия свободна).
 *  В данном примере не реализован разрыв голосового соединения функцией CALLend(), см. пример all.
 *  Если соединение будет разорвано во время набора или отклонено отвечающей стороной во время дозвона, то возможна установка голосового соединения с оператором для отправки голосового сообщения.
 *  Во время разговора используется громкая связь, для переключения на гарнитуру и обратно воспользуйтесь функцией SOUNDdevice(), см. пример all.
 */