//  Данный пример демонстрирует получение и отправку коротких SMS сообщений, а так же совершение и ответ на голосовые вызовы:
//  Если в мониторе последовательного порта ввести номер, то будет выполнен голосовой вызов.
//  Если в мониторе последовательного порта ввести номер и через пробел текст, то будет выполнена отправка SMS сообщения.
//  Если будет получено SMS сообщение, то оно отобразится в мониторе последовательного порта.
//  Если будет получен голосовой вызов, то в мониторе последовательного порта отобразится номер вызывающего абонента и подсказки дальнейших действий:
//  - введите '0' - сбросить вызов    (повесить трубку).
//  - введите '1' - ответить на вызов (поднять  трубку).
//  - введите '2' - перевести звук на гарнитуру.
//  - введите '3' - перевести звук на громкую связь.
//  - введите '4' - использовать только микрофон громкой связи.
//  - введите '5' - уменьшить громкость на одно деление (всего 8 делений: 0-нет, 1-тихо, ... 7-макс).
//  - введите '6' - увеличить громкость на одно деление (всего 8 делений: 0-нет, 1-тихо, ... 7-макс).
//  - введите '7' - включить/выключить немой режим (режим mute).
//  ==========================================================================================
    #include <iarduino_GSM.h>                                                                                           // Подключаем библиотеку iarduino_GSM для работы с GSM/GPRS Shield.
    iarduino_GSM gsm;                                                                                                   // Создаём объект gsm для работы с функциями и методами библиотеки iarduino_GSM.
                                                                                                                        //
//  Следующие 2 строки нужны для работы по программной шине UATR (выводы 7 и 8):                                        //
    #include <SoftwareSerial.h>                                                                                         // Подключаем библиотеку SoftwareSerial для программной реализации шины UART.
    SoftwareSerial softSerial(7,8);                                                                                     // Создаём объект softSerial указывая выводы RX и TX платы Arduino.
//  Если Вы работаете c GSM/GPRS Shield по аппаратной шине UATR, удалите 2 предыдущие строки,                           //
//  а в функции gsm.begin(), вместо softSerial укажите Serial или Serial1, Serial2 ...                                  // Зависит от номера аппаратной шины UART использующей выводы 0 и 1 Вашей платы Arduino.
                                                                                                                        //
    char     SMStxt[161];                                                                                               // Объявляем строку для хранения текста принятых SMS сообщений.
    char     SMSnum[ 13];                                                                                               // Объявляем строку для хранения номера отправителя SMS сообщений.
    char     SMStim[ 50];                                                                                               // Объявляем строку для хранения даты и времени отправки SMS сообщений.
    uint16_t SMSlongID;                                                                                                 // Объявляем переменную для хранения идентификатора составного SMS сообщения.
    uint8_t  SMSlongSUM;                                                                                                // Объявляем переменную для хранения количества SMS в составном сообщении.
    uint8_t  SMSlongNUM;                                                                                                // Объявляем переменную для хранения номера SMS в составном сообщении.
    uint8_t  i,j;                                                                                                       // Объявляем переменные для разных целей.
                                                                                                                        //
void setup(){                                                                                                           //
//  Выводим текст в монитор последовательного порта:                                                                    //
    Serial.begin(9600);                                                                                                 // Инициируем передачу данных по аппаратной шине UART для вывода результата в монитор последовательного порта.
    Serial.print( F("Initialization, please wait ... ") );                                                              // Выводим текст.
                                                                                                                        //
//  Инициируем GSM/GPRS Shield и проверяем его готовность к работе:                                                     //
    gsm.begin(softSerial);                                                                                              // Инициируем работу GSM/GPRS Shield, указывая объект шины UART.
    while(gsm.status()!=GSM_OK){Serial.print("."); delay(1000);} Serial.println(" OK!");                                // Ждём завершения регистрации модема в сети оператора связи.
    Serial.println( F("Enter the phone number to call") );                                                              // Введите телефонный номер для совершения вызова.
    Serial.println( F("Enter the phone number and text to sent SMS") );                                                 // Введите телефонный номер и текст для отправки сообщения.
    Serial.println( F("--------------------") );                                                                        //
                                                                                                                        //
//  Установка кодировки для символов Кириллицы:                                                                         //
    gsm.TXTsendCodingDetect("п");                                                                                       // Выполняем автоопределение кодировки скетча для отправки текста на Русском языке.
//  gsm.TXTsendCoding(GSM_TXT_CP866);                                                                                   // Если символы Кириллицы исходящих SMS сообщений некорректно отображаются на телефоне, выберите одну из кодировок: GSM_TXT_CP866 / GSM_TXT_UTF8 / GSM_TXT_WIN1251.
//  gsm.TXTreadCoding(GSM_TXT_CP866);                                                                                   // Если символы Кириллицы входящих  SMS сообщений некорректно отображаются в мониторе,  выберите одну из кодировок: GSM_TXT_CP866 / GSM_TXT_UTF8 / GSM_TXT_WIN1251.
}                                                                                                                       // По умолчанию для входящих и исходящих SMS сообщений установлена кодировка GSM_TXT_UTF8.
                                                                                                                        //
void loop (){                                                                                                           //
    if(millis()%1000<100){                                                                                              // Выполняем код в теле оператора if первые 100 мс каждой секунды.
    delay(100);                                                                                                         // Устанавливаем задержку в 100 мс, чтоб не выполнить код более 1 раза за секунду.
    if(gsm.SMSavailable()){                                                                                             // Функция SMSavailable() возвращает количество входящих непрочитанных SMS сообдений.
//  Проверяем наличие входящих SMS сообщений:                                                                           //
        Serial.println( F("SMS came, I read ...") );                                                                    // Выводим текст "Пришла SMS, читаю ... ".
        gsm.SMSread(SMStxt, SMSnum, SMStim, SMSlongID, SMSlongSUM, SMSlongNUM);                                         // Читаем SMS сообщение в ранее объявленные переменные (текст SMS сообщения, адрес отправителя, дата отправки, идентификатор SMS, количество SMS, номер SMS).
        Serial.print  ( F("SMS ")                   ); Serial.print  ( SMSlongNUM );                                    //
        Serial.print  ( F(" in ")                   ); Serial.print  ( SMSlongSUM );                                    //
        Serial.print  ( F(", ID=")                  ); Serial.print  ( SMSlongID );                                     //
        Serial.print  ( F(", sent on ")             ); Serial.print  ( SMStim );                                        //
        Serial.print  ( F(" from number ")          ); Serial.print  ( SMSnum );                                        //
        Serial.println( F(", message text:")        ); Serial.println( SMStxt );                                        //
        Serial.println( F("--------------------")   );                                                                  //
    }                                                                                                                   //
//  Проверяем наличие входящих голосовых вызовов:                                                                       //
    if(gsm.CALLavailable(SMSnum)){                                                                                      // Функция CALLavailable() возвращает true если есть входящий дозванивающийся вызов. В качестве аргумента функции можно указать строку в которую будет записан адрес (номер) вызывающего абонента.
//      Выводим оповещение о входящем вызове:                                                                           //
        Serial.print  ( F("Incoming call from the ")                );                                                  // Входящий вызов от.
        Serial.print  ( SMSnum                                      );                                                  // Адрес (номер) звонящего.
        Serial.println( F(" ...")                                   );                                                  // 
        Serial.println( F("  - enter '0' - complete")               );                                                  // - введите '0' - сбросить.
        Serial.println( F("  - enter '1' - reply")                  );                                                  // - введите '1' - ответить.
        Serial.println( F("  - enter '2' - select a HEADSET")       );                                                  // - введите '2' - выбрать гарнитуру.
        Serial.println( F("  - enter '3' - select a SPEAKER")       );                                                  // - введите '3' - выбрать громкую связь.
        Serial.println( F("  - enter '4' - select only MICROPHONE") );                                                  // - введите '4' - выбрать только микрофон громкой связи.
        Serial.println( F("  - enter '5' - volume --")              );                                                  // - введите '5' - что бы уменьшить громкость.
        Serial.println( F("  - enter '6' - volume ++")              );                                                  // - введите '6' - что бы увеличить громкость.
        Serial.println( F("  - enter '7' - mute on/off")            );                                                  // - введите '7' - включить/выключить немой режим (mute).
//      Ждём действий во время входящего голосового вызова:                                                             // Ждём ввода цифры из монитора последовательного порта для ответа или сброса.
        while(Serial.available()){Serial.read();}                                                                       // Чистим буфер UART от всех символов введённых из монитора последовательного порта.
        while(gsm.CALLavailable()){                                                                                     // Цикл while выполняется пока есть входящий вызов.
            if(Serial.available()){                                                                                     // Если в буфере UART есть символ введённый из монитора последовательного порта.
                switch( Serial.read() ){                                                                                // Читаем введённый символ.
                    case '0': Serial.println( F("Entered '0'")); gsm.CALLend();                               break;    // Если введен символ '0' то сбрасываем вызов функцией CALLend().
                    case '1': Serial.println( F("Entered '1'")); gsm.CALLup();                                break;    // Если введен символ '1' то отвечаем на вызов функцией CALLup().
                    case '2': Serial.println( F("Entered '2'")); gsm.SOUNDdevice(GSM_HEADSET);                break;    // Если введен символ '2' то выбираем гарнитуру функцией SOUNDdevice().
                    case '3': Serial.println( F("Entered '3'")); gsm.SOUNDdevice(GSM_SPEAKER);                break;    // Если введен символ '3' то выбираем громкую связь функцией SOUNDdevice().
                    case '4': Serial.println( F("Entered '4'")); gsm.SOUNDdevice(GSM_MICROPHONE);             break;    // Если введен символ '4' то выбираем только микрофон громкой связи функцией SOUNDdevice().
                    case '5': Serial.print  ( F("Entered '5'")); gsm.SOUNDvolume(gsm.SOUNDvolume()-1       );           // Если введен символ '5' то уменьшаем громкость динамика функцией SOUNDvolume(), она как устанавливает, так и возвращает громкость.
                              Serial.print  ( F(", volume = ")); Serial.println( gsm.SOUNDvolume()         ); break;    //                        Вот так выглядел бы код установки минимальной громкости: gsm.SOUNDvolume(1);
                    case '6': Serial.print  ( F("Entered '6'")); gsm.SOUNDvolume(gsm.SOUNDvolume()+1       );           // Если введен символ '6' то увеличиваем громкость динамика функцией SOUNDvolume(), она как устанавливает, так и возвращает громкость.
                              Serial.print  ( F(", volume = ")); Serial.println( gsm.SOUNDvolume()         ); break;    //                        Вот так выглядел бы код установки максимальной громкости: gsm.SOUNDvolume(7);
                    case '7': Serial.print  ( F("Entered '7'")); gsm.SOUNDmute (!gsm.SOUNDmute()           );           // Если введен символ '7' то вкл/выкл немой режим (откл микрофон) функцией SOUNDmute(), она как устанавливает, так и возвращает флаг наличия немого режима.
                              Serial.print  ( F(", mute is " )); Serial.println( gsm.SOUNDmute()?"on":"off"); break;    //                        Вот так выглядел бы код включения немого режима: gsm.SOUNDmute(true);
                }                                                                                                       //
                while(Serial.available()){Serial.read();}                                                               // Чистим буфер UART от всех остальных символов введённых из монитора последовательного порта.
            }                                                                                                           //
        }                                                                                                               //
//      Проверяем выполнено ли голосовое соединение:                                                                    //
        if(gsm.CALLstatus()==GSM_CALL_ACTIVE){                                                                          // Функция CALLstatus() возвращает статус текущего голосового вызова, значение GSM_CALL_ACTIVE указывает на наличие активного голосового соединения.
//          Выводим оповещение об установленном голосовом соединении:                                                   //
            Serial.println( F("Voice connection established ... ")      );                                              // Установлено голосовое соединение ...
            Serial.println( F("  - enter '0' - complete")               );                                              // - введите '0' - сбросить
            Serial.println( F("  - enter '2' - select a HEADSET")       );                                              // - введите '2' - выбрать гарнитуру.
            Serial.println( F("  - enter '3' - select a SPEAKER")       );                                              // - введите '3' - выбрать громкую связь.
            Serial.println( F("  - enter '4' - select only MICROPHONE") );                                              // - введите '4' - выбрать только микрофон громкой связи.
            Serial.println( F("  - enter '5' - volume --")              );                                              // - введите '5' - что бы уменьшить громкость.
            Serial.println( F("  - enter '6' - volume ++")              );                                              // - введите '6' - что бы увеличить громкость.
            Serial.println( F("  - enter '7' - mute on/off")            );                                              // - введите '7' - включить/выключить немой режим (mute).
//          Ждём действий во время разговора: (ждём ввода цифры '0' из монитора последовательного порта для сброса)     //
            while(Serial.available()){Serial.read();}                                                                   // Чистим буфер UART от всех символов введённых из монитора последовательного порта.
            while(gsm.CALLstatus()==GSM_CALL_ACTIVE){                                                                   // Цикл while выполняется пока установлено голосовое соединение.
              if(Serial.available()){                                                                                   // Если в буфере UART есть символ введённый из монитора последовательного порта.
                switch( Serial.read() ){                                                                                // Читаем введённый символ.
                  case '0': Serial.println( F("Entered '0'")); gsm.CALLend();                               break;      // Если введен символ '0' то сбрасываем вызов функцией CALLend().
                  case '2': Serial.println( F("Entered '2'")); gsm.SOUNDdevice(GSM_HEADSET);                break;      // Если введен символ '2' то выбираем гарнитуру функцией SOUNDdevice().
                  case '3': Serial.println( F("Entered '3'")); gsm.SOUNDdevice(GSM_SPEAKER);                break;      // Если введен символ '3' то выбираем громкую связь функцией SOUNDdevice().
                  case '4': Serial.println( F("Entered '4'")); gsm.SOUNDdevice(GSM_MICROPHONE);             break;      // Если введен символ '4' то выбираем только микрофон громкой связи функцией SOUNDdevice().
                  case '5': Serial.print  ( F("Entered '5'")); gsm.SOUNDvolume(gsm.SOUNDvolume()-1       );             // Если введен символ '5' то уменьшаем громкость динамика функцией SOUNDvolume(), она как устанавливает, так и возвращает громкость.
                            Serial.print  ( F(", volume = ")); Serial.println( gsm.SOUNDvolume()         ); break;      //                        Вот так выглядел бы код установки минимальной громкости: gsm.SOUNDvolume(1);
                  case '6': Serial.print  ( F("Entered '6'")); gsm.SOUNDvolume(gsm.SOUNDvolume()+1       );             // Если введен символ '6' то увеличиваем громкость динамика функцией SOUNDvolume(), она как устанавливает, так и возвращает громкость.
                            Serial.print  ( F(", volume = ")); Serial.println( gsm.SOUNDvolume()         ); break;      //                        Вот так выглядел бы код установки максимальной громкости: gsm.SOUNDvolume(7);
                  case '7': Serial.print  ( F("Entered '7'")); gsm.SOUNDmute (!gsm.SOUNDmute()           );             // Если введен символ '7' то вкл/выкл немой режим (откл микрофон) функцией SOUNDmute(), она как устанавливает, так и возвращает флаг наличия немого режима.
                            Serial.print  ( F(", mute is " )); Serial.println( gsm.SOUNDmute()?"on":"off"); break;      //                        Вот так выглядел бы код включения немого режима: gsm.SOUNDmute(true);
                }                                                                                                       //
                while(Serial.available()){Serial.read();}                                                               // Чистим буфер UART от всех остальных символов введённых из монитора последовательного порта.
              }                                                                                                         //
            }                                                                                                           //
//          Разговор завершён:                                                                                          // Попасть сюда можно только после выхода из цикла while(), значит функция CALLstatus() вернула значение отличное от GSM_CALL_ACTIVE
            Serial.println( F("Call ended") );                                                                          // Вызов завершён
        }else{                                                                                                          // Иначе, если голосовое соединение вообще не было установлено, значит либо в мониторе был изначально нажат 0, либо звонящий абонент сбросил вызов до ответа.
//          Голосовое соединение не установлено:                                                                        //
            Serial.println( F("Сall is rejected.") );                                                                   // Вызов отклонён, голосовое соединение не установлено.
        }                                                                                                               //
        Serial.println("--------------------");                                                                         //
    }                                                                                                                   //
//  Проверяем наличие данных введённых в монитор последовательного порта:                                               //
    i=0;                                                                                                                // Используем переменную i как счётчик прочитанных символов в строку SMSnum и SMStxt.
    j=0;                                                                                                                // Используем переменную j как флаг: 0-символы читаются в строку SMSnum, 1-символы читаются в строку SMStxt.
    if(Serial.available()){                                                                                             // Функция available() возвращает количество байт (символов) в буфере UART (введённых в мониторе последовательного порта).
        while(Serial.available()){                                                                                      // Цикл выполняется пока в буфере UART есть данные ...
            char k=Serial.read();                                                                                       // Читаем очередной символ в переменную k.
            if(j==0 && k==' '){ j=1; i=0;                                 }else                                         // Если встретился первый символ пробела, то остальные символы читаем в строку SMStxt.
            if(j==0)          { if(i<12 ){SMSnum[i]=k; i++; SMSnum[i]=0;} }else                                         // Если пробел еще не встречался то сохраняем очередной прочитанный символ из переменной k строку SMSnum, но не более 12  символов, увеличиваем счётчик i и заранее добавляем символ конца строки.
            if(j==1)          { if(i<160){SMStxt[i]=k; i++; SMStxt[i]=0;} }                                             // Если пробел уже    встречался то сохраняем очередной прочитанный символ из переменной k строку SMStxt, но не более 160 символов, увеличиваем счётчик i и заранее добавляем символ конца строки.
            delay(5);                                                                                                   // Устанавливаем задержку в 5 мс, во избежание досрочного выхода из цикла.
        }                                                                                                               //
        if( strlen(SMSnum)>=4 ){j+=2;}                                                                                  // Теперь используем переменную j как флаг дальнейших действий: 2-позвонить, 3-отправить SMS.
    }                                                                                                                   //
//  Проверяем необходимость совершения исходящего вызова:                                                               //
    if(j==2){                                                                                                           // Если в мониторе последовательного порта введён только номер, значит нужно выполнить голосовой вызов...
        Serial.print( F("Call to a phone number ") );                                                                   //
        Serial.print( SMSnum );                                                                                         //
        Serial.print( F(" ... ") );                                                                                     //
//      Инициируем исходящий вызов на указанный номер:                                                                  //
        if(gsm.CALLdial( SMSnum )){                                                                                     // Если исходящий вызов инициирован, то...
            Serial.println( F("Ок!") );                                                                                 //
            Serial.print(   F("Dialing ... ") );                                                                        //
//          Ждём завершения набора номера:                                                                              //
            while(gsm.CALLstatus()==GSM_CALL_OUT_DIAL){                                                                 // Цикл выполняется пока набирается номер ...
//              Можно добавить код который будет выполняться в процессе набора номера                                   //
            }                                                                                                           //
            delay(500);                                                                                                 // Даём немного времени для установки состояния - дозвон.
            if(gsm.CALLstatus()==GSM_CALL_OUT_BEEP){                                                                    // Если начались гудки дозвона, то ...
                Serial.println( F("Ок!") );                                                                             //
                Serial.print(   F("Waiting for an answer ... ") );                                                      // Ждём ответа
//              Ждём поднятия трубки на вызываемой стороне:                                                             //
                while(gsm.CALLstatus()==GSM_CALL_OUT_BEEP){                                                             // Цикл выполняется пока идут гудки дозвона ...
//                  Можно добавить код который будет выполняться в процессе ожидания ответа                             //
                }                                                                                                       //
                delay(500);                                                                                             // Даём немного времени для установки состояния - соединён.
            }                                                                                                           //
            if(gsm.CALLstatus()==GSM_CALL_ACTIVE){                                                                      // Если абонент ответил, то ...
                Serial.println( F("Ок!")                                    );                                          //
                Serial.println( F("Voice connection established ... ")      );                                          // Установлено голосовое соединение ...
                Serial.println( F("  - enter '0' - complete")               );                                          // - введите '0' - сбросить
                Serial.println( F("  - enter '2' - select a HEADSET")       );                                          // - введите '2' - выбрать гарнитуру.
                Serial.println( F("  - enter '3' - select a SPEAKER")       );                                          // - введите '3' - выбрать громкую связь.
                Serial.println( F("  - enter '4' - select only MICROPHONE") );                                          // - введите '4' - выбрать только микрофон громкой связи.
                Serial.println( F("  - enter '5' - volume --")              );                                          // - введите '5' - что бы уменьшить громкость.
                Serial.println( F("  - enter '6' - volume ++")              );                                          // - введите '6' - что бы увеличить громкость.
                Serial.println( F("  - enter '7' - mute on/off")            );                                          // - введите '7' - включить/выключить немой режим (mute).
//              Ждём завершения активного голосового соединения:                                                        //
                while(gsm.CALLstatus()==GSM_CALL_ACTIVE){                                                               // Цикл выполняется пока установлено активное голосовое соединение ...
                   if(Serial.available()){                                                                              // Если в буфере UART есть символ введённый из монитора последовательного порта.
                     switch( Serial.read() ){                                                                           // Читаем введённый символ.
                       case '0': Serial.println( F("Entered '0'")); gsm.CALLend();                               break; // Если введен символ '0' то сбрасываем вызов функцией CALLend().
                       case '2': Serial.println( F("Entered '2'")); gsm.SOUNDdevice(GSM_HEADSET);                break; // Если введен символ '2' то выбираем гарнитуру функцией SOUNDdevice().
                       case '3': Serial.println( F("Entered '3'")); gsm.SOUNDdevice(GSM_SPEAKER);                break; // Если введен символ '3' то выбираем громкую связь функцией SOUNDdevice().
                       case '4': Serial.println( F("Entered '4'")); gsm.SOUNDdevice(GSM_MICROPHONE);             break; // Если введен символ '4' то выбираем только микрофон громкой связи функцией SOUNDdevice().
                       case '5': Serial.print  ( F("Entered '5'")); gsm.SOUNDvolume(gsm.SOUNDvolume()-1       );        // Если введен символ '5' то уменьшаем громкость динамика функцией SOUNDvolume(), она как устанавливает, так и возвращает громкость.
                                 Serial.print  ( F(", volume = ")); Serial.println( gsm.SOUNDvolume()         ); break; //                        Вот так выглядел бы код установки минимальной громкости: gsm.SOUNDvolume(1);
                       case '6': Serial.print  ( F("Entered '6'")); gsm.SOUNDvolume(gsm.SOUNDvolume()+1       );        // Если введен символ '6' то увеличиваем громкость динамика функцией SOUNDvolume(), она как устанавливает, так и возвращает громкость.
                                 Serial.print  ( F(", volume = ")); Serial.println( gsm.SOUNDvolume()         ); break; //                        Вот так выглядел бы код установки максимальной громкости: gsm.SOUNDvolume(7);
                       case '7': Serial.print  ( F("Entered '7'")); gsm.SOUNDmute (!gsm.SOUNDmute()           );        // Если введен символ '7' то вкл/выкл немой режим (откл микрофон) функцией SOUNDmute(), она как устанавливает, так и возвращает флаг наличия немого режима.
                                 Serial.print  ( F(", mute is " )); Serial.println( gsm.SOUNDmute()?"on":"off"); break; //                        Вот так выглядел бы код включения немого режима: gsm.SOUNDmute(true);
                     }                                                                                                  //
                     while(Serial.available()){Serial.read();}                                                          // Чистим буфер UART от всех остальных символов введённых из монитора последовательного порта.
                   }                                                                                                    //
                }                                                                                                       //
//              Разговор завершён:                                                                                      // Попасть сюда можно только после выхода из цикла while(), значит функция CALLstatus() вернула значение отличное от GSM_CALL_ACTIVE
                Serial.println( F("Call ended") );                                                                      // Вызов завершён
            }else{                                                                                                      // Иначе, если абонент не ответил, то ...
//              Если абонент не отвечает или не удалось набрать номер:                                                  //
                Serial.println( F("No answer!") );                                                                      // Абонент не отвечает.
            }                                                                                                           //
        }else{                                                                                                          // Иначе, если исходящий вызов невозможен, то ...
//          Если не удалось инициировать исходящий вызов:                                                               //
            Serial.println( F("Error!") );                                                                              //
        }                                                                                                               //
        Serial.println("--------------------");                                                                         //
    }                                                                                                                   //
//  Проверяем необходимость отправки короткого SMS сообщения:                                                           //
    if(j==3){                                                                                                           // Если в мониторе последовательного порта введён только номер, значит нужно выполнить голосовой вызов...
        Serial.print(F("Sending normal SMS ... "));                                                                     //
//      Отправкляем короткое SMS сообщение с текстом SMStxt на номер SMSnum:                                            //
        gsm.TXTsendCoding(GSM_TXT_WIN1251);                                                                             // Так как текст сообщения в строке SMStxt был введён из монитора последовательного порта, то его кодировка МОЖЕТ отличаться от кодировки скетча. В примере это кодировка WIN1251, которую приходится указывать вручную (можно указать кодировки GSM_TXT_CP866, GSM_TXT_UTF8, GSM_TXT_WIN1251).
        if(gsm.SMSsend( SMStxt, SMSnum )){                                                                              // Если SMS сообщение с текстом SMStxt будет отправлено на номер SMSnum, то ...
            Serial.println(F("OK!"));                                                                                   // Выводим текст "OK!"
        }else{                                                                                                          // Иначе, если SMS сообщение не отправлено, то ...
            Serial.println(F("Error!"));                                                                                // Выводим текст "Error!"
        }                                                                                                               //
        gsm.TXTsendCodingDetect("п");                                                                                   // Кодировка отправленного текста отличалась от кодировки скетча, выполняем автоопределение кодировки скетча, для отправки SMS с текстом из ОЗУ или ПЗУ скетча (если таковые есть).
        Serial.println("--------------------");                                                                         //
    }                                                                                                                   //
}                                                                                                                       //
}                                                                                                                       //