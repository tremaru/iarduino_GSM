//  Данный пример демонстрирует автоматическую перезагрузку модуля при его "зависании":
//  ==========================================================================================
    #define pinPWR 7                                                                          // Вывод Arduino используемый для включения  GSM/GPRS Shield A9.
    #define pinRX  8                                                                          // Вывод Arduino RX подключаемый к выводу TX GSM/GPRS Shield A9.
    #define pinTX  9                                                                          // Вывод Arduino TX подключаемый к выводу RX GSM/GPRS Shield A9.
                                                                                              //
//  Следующие 2 строки нужны для работы по программной шине UATR:                             //
    #include <SoftwareSerial.h>                                                               // Подключаем библиотеку SoftwareSerial для программной реализации шины UART, до подключения библиотеки iarduino_GSM.
    SoftwareSerial softSerial(pinRX, pinTX);                                                  // Создаём объект softSerial указав выводы RX и TX Arduino используемые для программной шины UART.
//  Если Вы работаете c GSM/GPRS Shield по аппаратной шине UATR, удалите 2 предыдущие строки, //
//  а в функции gsm.begin(), вместо softSerial укажите Serial или Serial1, Serial2 ...        // Зависит от номера аппаратной шины UART вашей платы Arduino.
                                                                                              //
    #include <iarduino_GSM.h>                                                                 // Подключаем библиотеку iarduino_GSM для работы с GSM/GPRS Shield.
    iarduino_GSM gsm(pinPWR);                                                                 // Создаём объект gsm для работы с функциями и методами библиотеки iarduino_GSM, указав вывод PWR.
                                                                                              //
uint8_t        cnt=0;                                                                         // Определяем переменную для хранения количества зафиксированных подряд ошибок.
                                                                                              //
void setup(){                                                                                 //
    gsm.begin(softSerial);                                                                    // Инициируем работу GSM/GPRS Shield, указывая объект шины UART.
//  Ждём завершения регистрации модема в сети оператора:                                      //
    for(int i=0; i<120; i++){ delay(1000);                                                    // Выполняем цикл 120 раз примерно за 120 секунд ...
        if (gsm.status()==GSM_OK){i=120;}                                                     // Если модуль готов к работе, то досрочно выходим из цикла for().
    }                                                                                         //
}                                                                                             //
                                                                                              //
void loop(){                                                                                  //
//  Место для основного кода программы:                                                       //
//  ...                                                                                       //
//  Код проверки работоспособности модуля:                                                    //
    if (millis()%60000 < 1000){ delay(1000);                                                  // Разрешаем выполнять код в теле оператора if один раз в минуту ...
//      Считаем количество ошибок состояния модуля:                                           //
        if (gsm.runAT("AT\r\n").indexOf("OK")<0){cnt++;}else                                  // Если модуль не ответил OK на команду AT, то увеличиваем счётчик ошибок cnt.
        if (gsm.status() != GSM_OK             ){cnt++;}else                                  // Если статус модуля отличен от GSM_OK   , то увеличиваем счётчик ошибок cnt.
                                                {cnt=0;}                                      // Иначе (если модуль работает корректно) , то сбрасываем  счётчик ошибок cnt.
//      Перезагружаем модуль если было 3 ошибки подряд:                                       //
        if (cnt>3){                                                                           // Если зафиксировано более 3 ошибок подряд, то ...
            cnt=0;                                                                            // Сбрасываем счётчик количества обнаруженных подряд ошибок.
            gsm.reset();                                                                      // Перезагружаем модуль (выполняется более чем за 2 секунды).
//          Ждём завершения регистрации модема в сети:                                        //
            for(int i=0; i<120; i++){ delay(1000);                                            // Выполняем цикл 120 раз примерно за 120 секунд ...
                if (gsm.status()==GSM_OK){i=120;}                                             // Если модуль готов к работе, то досрочно выходим из цикла for().
            }                                                                                 //
        }                                                                                     //
    }                                                                                         //
//  Место для основного кода программы:                                                       //
//  ...                                                                                       //
}                                                                                             //